## config/west.yml
```yaml
manifest:
  remotes:
    - name: zmkfirmware
      url-base: https://github.com/petejohanson
    - name: sayu-hub
      url-base: https://github.com/sayu-hub
    - name: caksoylar  # <-- led
      url-base: https://github.com/caksoylar  
    - name: joelspadin # <-- send-string
      url-base: https://github.com/joelspadin
  projects:
    - name: zmk
      remote: zmkfirmware
      revision: feat/pointers-move-scroll
      import: app/west.yml
    - name: zmk-pmw3610-driver  # <-- トラボドライバ
      remote: sayu-hub
      revision: main
    - name: zmk-rgbled-widget  # <-- led
      remote: caksoylar
      revision: main
    - name: zmk-string  # <-- send-string
      remote: joelspadin
      revision: send-string-behavior
  self:
    path: config
```
